## main/Kconfig.projbuild
```kconfig
menu "Example Configuration"

    menu "SoftAP Configuration"
        comment "SoftAP Configuration"

        config ESP_WIFI_AP_SSID
            string "WiFi AP SSID"
            default "myssid"
            help
                SSID (network name) of the AP for the example to connect to.

        config ESP_WIFI_AP_PASSWORD
            string "WiFi AP Password"
            default "mypassword"
            help
                WiFi password of the AP for the example to use.

        config ESP_WIFI_AP_CHANNEL
            int "WiFi AP Channel"
            range 1 14
            default 1
            help
                WiFi channel (network channel) of the AP for the example to use.

        config ESP_MAX_STA_CONN_AP
            int "Maximal STA connections"
            default 4
            help
                Max number of the STA connects to AP.
    endmenu
    
    menu "e-paper Configuration"
        comment "e-paper Configuration"

        config EPD_BUSY_PIN
            int "EPD_BUSY_PIN"
            default 20
            help
                SPI BUSY PIN number.

        config EPD_RST_PIN
            int "EPD_RST_PIN"
            default 6
            help
                SPI RST PIN number.

        config EPD_DC_PIN
            int "EPD_DC_PIN"
            default 18
            help
                SPI DC PIN number.

        config EPD_CS_PIN
            int "EPD_CS_PIN"
            default 16
            help
                SPI CS PIN number.
                
        config EPD_SCK_PIN
            int "EPD_SCK_PIN"
            default 10
            help
                SPI SCK PIN number.
                
        config EPD_MOSI_PIN
            int "EPD_MOSI_PIN"
            default 11
            help
                SPI MOSI PIN number.

        config WEATHER_API_KEY
            string "Weather forcast api key"
            default "***"
            help
                Weather forcast api key for the example to use.
    endmenu
endmenu
```
